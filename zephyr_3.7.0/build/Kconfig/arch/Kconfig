## zephyr_3.7.0/build/Kconfig/arch/Kconfig
```kconfig
# Load arch Kconfig descriptions.
osource "/home/frank/zephyrproject/zephyr/arch/x86/Kconfig"
osource "/home/frank/zephyrproject/zephyr/arch/xtensa/Kconfig"
osource "/home/frank/zephyrproject/zephyr/arch/sparc/Kconfig"
osource "/home/frank/zephyrproject/zephyr/arch/riscv/Kconfig"
osource "/home/frank/zephyrproject/zephyr/arch/posix/Kconfig"
osource "/home/frank/zephyrproject/zephyr/arch/nios2/Kconfig"
osource "/home/frank/zephyrproject/zephyr/arch/mips/Kconfig"
osource "/home/frank/zephyrproject/zephyr/arch/arm64/Kconfig"
osource "/home/frank/zephyrproject/zephyr/arch/arm/Kconfig"
osource "/home/frank/zephyrproject/zephyr/arch/arc/Kconfig"
```

## zephyr_3.7.0/build/Kconfig/soc/Kconfig
```kconfig
# Load Zephyr SoC Kconfig descriptions.
osource "/home/frank/zephyrproject/zephyr/soc/xlnx/zynqmp/Kconfig"
osource "/home/frank/zephyrproject/zephyr/soc/xlnx/zynq7000/Kconfig"
osource "/home/frank/zephyrproject/zephyr/soc/xen/Kconfig"
osource "/home/frank/zephyrproject/zephyr/soc/ti/simplelink/Kconfig"
osource "/home/frank/zephyrproject/zephyr/soc/ti/lm3s6965/Kconfig"
osource "/home/frank/zephyrproject/zephyr/soc/ti/k3/Kconfig"
osource "/home/frank/zephyrproject/zephyr/soc/telink/tlsr/Kconfig"
osource "/home/frank/zephyrproject/zephyr/soc/starfive/jh71xx/Kconfig"
osource "/home/frank/zephyrproject/zephyr/soc/st/stm32/Kconfig"
osource "/home/frank/zephyrproject/zephyr/soc/snps/qemu_arc/Kconfig"
osource "/home/frank/zephyrproject/zephyr/soc/snps/nsim/arc_v/Kconfig"
osource "/home/frank/zephyrproject/zephyr/soc/snps/nsim/arc_classic/Kconfig"
osource "/home/frank/zephyrproject/zephyr/soc/snps/hsdk4xd/Kconfig"
osource "/home/frank/zephyrproject/zephyr/soc/snps/hsdk/Kconfig"
osource "/home/frank/zephyrproject/zephyr/soc/snps/emsk/Kconfig"
osource "/home/frank/zephyrproject/zephyr/soc/snps/emsdp/Kconfig"
osource "/home/frank/zephyrproject/zephyr/soc/snps/arc_iot/Kconfig"
osource "/home/frank/zephyrproject/zephyr/soc/silabs/Kconfig"
osource "/home/frank/zephyrproject/zephyr/soc/sifive/sifive_freedom/Kconfig"
osource "/home/frank/zephyrproject/zephyr/soc/rockchip/Kconfig"
osource "/home/frank/zephyrproject/zephyr/soc/renode/riscv_virtual/Kconfig"
osource "/home/frank/zephyrproject/zephyr/soc/renesas/smartbond/Kconfig"
osource "/home/frank/zephyrproject/zephyr/soc/renesas/rzt2m/Kconfig"
osource "/home/frank/zephyrproject/zephyr/soc/renesas/rcar/Kconfig"
osource "/home/frank/zephyrproject/zephyr/soc/renesas/ra/Kconfig"
osource "/home/frank/zephyrproject/zephyr/soc/raspberrypi/Kconfig"
osource "/home/frank/zephyrproject/zephyr/soc/quicklogic/eos_s3/Kconfig"
osource "/home/frank/zephyrproject/zephyr/soc/qemu/virt_riscv/Kconfig"
osource "/home/frank/zephyrproject/zephyr/soc/qemu/malta/Kconfig"
osource "/home/frank/zephyrproject/zephyr/soc/openisa/rv32m1/Kconfig"
osource "/home/frank/zephyrproject/zephyr/soc/nxp/s32/Kconfig"
osource "/home/frank/zephyrproject/zephyr/soc/nxp/rw/Kconfig"
osource "/home/frank/zephyrproject/zephyr/soc/nxp/mcx/Kconfig"
osource "/home/frank/zephyrproject/zephyr/soc/nxp/lpc/Kconfig"
osource "/home/frank/zephyrproject/zephyr/soc/nxp/layerscape/Kconfig"
osource "/home/frank/zephyrproject/zephyr/soc/nxp/kinetis/Kconfig"
osource "/home/frank/zephyrproject/zephyr/soc/nxp/imxrt/Kconfig"
osource "/home/frank/zephyrproject/zephyr/soc/nxp/imx/Kconfig"
osource "/home/frank/zephyrproject/zephyr/soc/nuvoton/numicro/Kconfig"
osource "/home/frank/zephyrproject/zephyr/soc/nuvoton/numaker/Kconfig"
osource "/home/frank/zephyrproject/zephyr/soc/nuvoton/npcx/Kconfig"
osource "/home/frank/zephyrproject/zephyr/soc/nordic/Kconfig"
osource "/home/frank/zephyrproject/zephyr/soc/neorv32/Kconfig"
osource "/home/frank/zephyrproject/zephyr/soc/native/inf_clock/Kconfig"
osource "/home/frank/zephyrproject/zephyr/soc/microchip/miv/Kconfig"
osource "/home/frank/zephyrproject/zephyr/soc/microchip/mec/Kconfig"
osource "/home/frank/zephyrproject/zephyr/soc/mediatek/mtk_adsp/Kconfig"
osource "/home/frank/zephyrproject/zephyr/soc/lowrisc/opentitan/Kconfig"
osource "/home/frank/zephyrproject/zephyr/soc/litex/litex_vexriscv/Kconfig"
osource "/home/frank/zephyrproject/zephyr/soc/ite/ec/Kconfig"
osource "/home/frank/zephyrproject/zephyr/soc/intel/raptor_lake/Kconfig"
osource "/home/frank/zephyrproject/zephyr/soc/intel/lakemont/Kconfig"
osource "/home/frank/zephyrproject/zephyr/soc/intel/intel_socfpga_std/Kconfig"
osource "/home/frank/zephyrproject/zephyr/soc/intel/intel_socfpga/Kconfig"
osource "/home/frank/zephyrproject/zephyr/soc/intel/intel_niosv/Kconfig"
osource "/home/frank/zephyrproject/zephyr/soc/intel/intel_ish/Kconfig"
osource "/home/frank/zephyrproject/zephyr/soc/intel/intel_adsp/Kconfig"
osource "/home/frank/zephyrproject/zephyr/soc/intel/elkhart_lake/Kconfig"
osource "/home/frank/zephyrproject/zephyr/soc/intel/atom/Kconfig"
osource "/home/frank/zephyrproject/zephyr/soc/intel/apollo_lake/Kconfig"
osource "/home/frank/zephyrproject/zephyr/soc/intel/alder_lake/Kconfig"
osource "/home/frank/zephyrproject/zephyr/soc/infineon/cat3/Kconfig"
osource "/home/frank/zephyrproject/zephyr/soc/infineon/cat1b/Kconfig"
osource "/home/frank/zephyrproject/zephyr/soc/infineon/cat1a/Kconfig"
osource "/home/frank/zephyrproject/zephyr/soc/gd/gd32/Kconfig"
osource "/home/frank/zephyrproject/zephyr/soc/gaisler/leon3/Kconfig"
osource "/home/frank/zephyrproject/zephyr/soc/gaisler/gr716a/Kconfig"
osource "/home/frank/zephyrproject/zephyr/soc/espressif/Kconfig"
osource "/home/frank/zephyrproject/zephyr/soc/ene/kb1200/Kconfig"
osource "/home/frank/zephyrproject/zephyr/soc/efinix/sapphire/Kconfig"
osource "/home/frank/zephyrproject/zephyr/soc/cdns/xtensa_sample_controller/Kconfig"
osource "/home/frank/zephyrproject/zephyr/soc/cdns/dc233c/Kconfig"
osource "/home/frank/zephyrproject/zephyr/soc/brcm/bcmvk/Kconfig"
osource "/home/frank/zephyrproject/zephyr/soc/brcm/bcm2712/Kconfig"
osource "/home/frank/zephyrproject/zephyr/soc/brcm/bcm2711/Kconfig"
osource "/home/frank/zephyrproject/zephyr/soc/atmel/sam0/Kconfig"
osource "/home/frank/zephyrproject/zephyr/soc/atmel/sam/Kconfig"
osource "/home/frank/zephyrproject/zephyr/soc/aspeed/Kconfig"
osource "/home/frank/zephyrproject/zephyr/soc/arm/Kconfig"
osource "/home/frank/zephyrproject/zephyr/soc/arm/beetle/Kconfig"
osource "/home/frank/zephyrproject/zephyr/soc/andestech/Kconfig"
osource "/home/frank/zephyrproject/zephyr/soc/ambiq/Kconfig"
osource "/home/frank/zephyrproject/zephyr/soc/altr/zephyr_nios2f/Kconfig"
osource "/home/frank/zephyrproject/zephyr/soc/altr/qemu_nios2/Kconfig"
osource "/home/frank/zephyrproject/zephyr/soc/adi/max32/Kconfig"
```

## zephyr_3.7.0/build/Kconfig/soc/Kconfig.sysbuild
```kconfig
# Load SoC sysbuild Kconfig descriptions.
osource "/home/frank/zephyrproject/zephyr/soc/xlnx/zynqmp/Kconfig.sysbuild"
osource "/home/frank/zephyrproject/zephyr/soc/xlnx/zynq7000/Kconfig.sysbuild"
osource "/home/frank/zephyrproject/zephyr/soc/xen/Kconfig.sysbuild"
osource "/home/frank/zephyrproject/zephyr/soc/ti/simplelink/Kconfig.sysbuild"
osource "/home/frank/zephyrproject/zephyr/soc/ti/lm3s6965/Kconfig.sysbuild"
osource "/home/frank/zephyrproject/zephyr/soc/ti/k3/Kconfig.sysbuild"
osource "/home/frank/zephyrproject/zephyr/soc/telink/tlsr/Kconfig.sysbuild"
osource "/home/frank/zephyrproject/zephyr/soc/starfive/jh71xx/Kconfig.sysbuild"
osource "/home/frank/zephyrproject/zephyr/soc/st/stm32/Kconfig.sysbuild"
osource "/home/frank/zephyrproject/zephyr/soc/snps/qemu_arc/Kconfig.sysbuild"
osource "/home/frank/zephyrproject/zephyr/soc/snps/nsim/arc_v/Kconfig.sysbuild"
osource "/home/frank/zephyrproject/zephyr/soc/snps/nsim/arc_classic/Kconfig.sysbuild"
osource "/home/frank/zephyrproject/zephyr/soc/snps/hsdk4xd/Kconfig.sysbuild"
osource "/home/frank/zephyrproject/zephyr/soc/snps/hsdk/Kconfig.sysbuild"
osource "/home/frank/zephyrproject/zephyr/soc/snps/emsk/Kconfig.sysbuild"
osource "/home/frank/zephyrproject/zephyr/soc/snps/emsdp/Kconfig.sysbuild"
osource "/home/frank/zephyrproject/zephyr/soc/snps/arc_iot/Kconfig.sysbuild"
osource "/home/frank/zephyrproject/zephyr/soc/silabs/Kconfig.sysbuild"
osource "/home/frank/zephyrproject/zephyr/soc/sifive/sifive_freedom/Kconfig.sysbuild"
osource "/home/frank/zephyrproject/zephyr/soc/rockchip/Kconfig.sysbuild"
osource "/home/frank/zephyrproject/zephyr/soc/renode/riscv_virtual/Kconfig.sysbuild"
osource "/home/frank/zephyrproject/zephyr/soc/renesas/smartbond/Kconfig.sysbuild"
osource "/home/frank/zephyrproject/zephyr/soc/renesas/rzt2m/Kconfig.sysbuild"
osource "/home/frank/zephyrproject/zephyr/soc/renesas/rcar/Kconfig.sysbuild"
osource "/home/frank/zephyrproject/zephyr/soc/renesas/ra/Kconfig.sysbuild"
osource "/home/frank/zephyrproject/zephyr/soc/raspberrypi/Kconfig.sysbuild"
osource "/home/frank/zephyrproject/zephyr/soc/quicklogic/eos_s3/Kconfig.sysbuild"
osource "/home/frank/zephyrproject/zephyr/soc/qemu/virt_riscv/Kconfig.sysbuild"
osource "/home/frank/zephyrproject/zephyr/soc/qemu/malta/Kconfig.sysbuild"
osource "/home/frank/zephyrproject/zephyr/soc/openisa/rv32m1/Kconfig.sysbuild"
osource "/home/frank/zephyrproject/zephyr/soc/nxp/s32/Kconfig.sysbuild"
osource "/home/frank/zephyrproject/zephyr/soc/nxp/rw/Kconfig.sysbuild"
osource "/home/frank/zephyrproject/zephyr/soc/nxp/mcx/Kconfig.sysbuild"
osource "/home/frank/zephyrproject/zephyr/soc/nxp/lpc/Kconfig.sysbuild"
osource "/home/frank/zephyrproject/zephyr/soc/nxp/layerscape/Kconfig.sysbuild"
osource "/home/frank/zephyrproject/zephyr/soc/nxp/kinetis/Kconfig.sysbuild"
osource "/home/frank/zephyrproject/zephyr/soc/nxp/imxrt/Kconfig.sysbuild"
osource "/home/frank/zephyrproject/zephyr/soc/nxp/imx/Kconfig.sysbuild"
osource "/home/frank/zephyrproject/zephyr/soc/nuvoton/numicro/Kconfig.sysbuild"
osource "/home/frank/zephyrproject/zephyr/soc/nuvoton/numaker/Kconfig.sysbuild"
osource "/home/frank/zephyrproject/zephyr/soc/nuvoton/npcx/Kconfig.sysbuild"
osource "/home/frank/zephyrproject/zephyr/soc/nordic/Kconfig.sysbuild"
osource "/home/frank/zephyrproject/zephyr/soc/neorv32/Kconfig.sysbuild"
osource "/home/frank/zephyrproject/zephyr/soc/native/inf_clock/Kconfig.sysbuild"
osource "/home/frank/zephyrproject/zephyr/soc/microchip/miv/Kconfig.sysbuild"
osource "/home/frank/zephyrproject/zephyr/soc/microchip/mec/Kconfig.sysbuild"
osource "/home/frank/zephyrproject/zephyr/soc/mediatek/mtk_adsp/Kconfig.sysbuild"
osource "/home/frank/zephyrproject/zephyr/soc/lowrisc/opentitan/Kconfig.sysbuild"
osource "/home/frank/zephyrproject/zephyr/soc/litex/litex_vexriscv/Kconfig.sysbuild"
osource "/home/frank/zephyrproject/zephyr/soc/ite/ec/Kconfig.sysbuild"
osource "/home/frank/zephyrproject/zephyr/soc/intel/raptor_lake/Kconfig.sysbuild"
osource "/home/frank/zephyrproject/zephyr/soc/intel/lakemont/Kconfig.sysbuild"
osource "/home/frank/zephyrproject/zephyr/soc/intel/intel_socfpga_std/Kconfig.sysbuild"
osource "/home/frank/zephyrproject/zephyr/soc/intel/intel_socfpga/Kconfig.sysbuild"
osource "/home/frank/zephyrproject/zephyr/soc/intel/intel_niosv/Kconfig.sysbuild"
osource "/home/frank/zephyrproject/zephyr/soc/intel/intel_ish/Kconfig.sysbuild"
osource "/home/frank/zephyrproject/zephyr/soc/intel/intel_adsp/Kconfig.sysbuild"
osource "/home/frank/zephyrproject/zephyr/soc/intel/elkhart_lake/Kconfig.sysbuild"
osource "/home/frank/zephyrproject/zephyr/soc/intel/atom/Kconfig.sysbuild"
osource "/home/frank/zephyrproject/zephyr/soc/intel/apollo_lake/Kconfig.sysbuild"
osource "/home/frank/zephyrproject/zephyr/soc/intel/alder_lake/Kconfig.sysbuild"
osource "/home/frank/zephyrproject/zephyr/soc/infineon/cat3/Kconfig.sysbuild"
osource "/home/frank/zephyrproject/zephyr/soc/infineon/cat1b/Kconfig.sysbuild"
osource "/home/frank/zephyrproject/zephyr/soc/infineon/cat1a/Kconfig.sysbuild"
osource "/home/frank/zephyrproject/zephyr/soc/gd/gd32/Kconfig.sysbuild"
osource "/home/frank/zephyrproject/zephyr/soc/gaisler/leon3/Kconfig.sysbuild"
osource "/home/frank/zephyrproject/zephyr/soc/gaisler/gr716a/Kconfig.sysbuild"
osource "/home/frank/zephyrproject/zephyr/soc/espressif/Kconfig.sysbuild"
osource "/home/frank/zephyrproject/zephyr/soc/ene/kb1200/Kconfig.sysbuild"
osource "/home/frank/zephyrproject/zephyr/soc/efinix/sapphire/Kconfig.sysbuild"
osource "/home/frank/zephyrproject/zephyr/soc/cdns/xtensa_sample_controller/Kconfig.sysbuild"
osource "/home/frank/zephyrproject/zephyr/soc/cdns/dc233c/Kconfig.sysbuild"
osource "/home/frank/zephyrproject/zephyr/soc/brcm/bcmvk/Kconfig.sysbuild"
osource "/home/frank/zephyrproject/zephyr/soc/brcm/bcm2712/Kconfig.sysbuild"
osource "/home/frank/zephyrproject/zephyr/soc/brcm/bcm2711/Kconfig.sysbuild"
osource "/home/frank/zephyrproject/zephyr/soc/atmel/sam0/Kconfig.sysbuild"
osource "/home/frank/zephyrproject/zephyr/soc/atmel/sam/Kconfig.sysbuild"
osource "/home/frank/zephyrproject/zephyr/soc/aspeed/Kconfig.sysbuild"
osource "/home/frank/zephyrproject/zephyr/soc/arm/Kconfig.sysbuild"
osource "/home/frank/zephyrproject/zephyr/soc/arm/beetle/Kconfig.sysbuild"
osource "/home/frank/zephyrproject/zephyr/soc/andestech/Kconfig.sysbuild"
osource "/home/frank/zephyrproject/zephyr/soc/ambiq/Kconfig.sysbuild"
osource "/home/frank/zephyrproject/zephyr/soc/altr/zephyr_nios2f/Kconfig.sysbuild"
osource "/home/frank/zephyrproject/zephyr/soc/altr/qemu_nios2/Kconfig.sysbuild"
osource "/home/frank/zephyrproject/zephyr/soc/adi/max32/Kconfig.sysbuild"
```
