## CMakeLists.txt
```
# SPDX-License-Identifier: Apache-2.0

cmake_minimum_required(VERSION 3.13.1)

find_package(Zephyr REQUIRED HINTS $ENV{ZEPHYR_BASE})
project(hello_world)

target_sources(app PRIVATE src/main.c )
zephyr_include_directories(${ZEPHYR_BASE}/boards/arm/bbc_microbit_v2)
```

## prj.conf
```kconfig
# Incresed stack due to settings API usage
CONFIG_SYSTEM_WORKQUEUE_STACK_SIZE=2048

CONFIG_BT=y

# Security manager protocol support for pairing
CONFIG_BT_SMP=y
# used to sign authenticated data
CONFIG_BT_SIGNING=y
# select peripheral role
CONFIG_BT_PERIPHERAL=y
# enable GATT device information service
CONFIG_BT_DIS=n
# number of buffers available for GATT writing
CONFIG_BT_ATT_PREPARE_COUNT=5
# enable battery service
#CONFIG_BT_BAS=y
# enable Heartrate service
#CONFIG_BT_HRS=y
# enables local privacy feature support (Random MAC)
CONFIG_BT_PRIVACY=n
# name that appears when browsing
CONFIG_BT_DEVICE_NAME="Microbit V2 BLE"
# https://specificationrefs.bluetooth.com/assigned-values/Appearance%20Values.pdf
# 833 = 0x341 = Heartrate belt
#CONFIG_BT_DEVICE_APPEARANCE=833
# 0x4c0 = generic control device = 1216
CONFIG_BT_DEVICE_APPEARANCE=1216
# disable updating of device name to prevent use of generic name
# enable run-time changing of device name
CONFIG_BT_DEVICE_NAME_DYNAMIC=n
CONFIG_BT_DEVICE_NAME_MAX=65

CONFIG_BT_KEYS_OVERWRITE_OLDEST=y
CONFIG_BT_SETTINGS=n
CONFIG_FLASH=y
CONFIG_FLASH_PAGE_LAYOUT=y
CONFIG_FLASH_MAP=y
CONFIG_NVS=y
CONFIG_SETTINGS=y


CONFIG_STDOUT_CONSOLE=y
CONFIG_CBPRINTF_FP_SUPPORT=y

CONFIG_STDOUT_CONSOLE=y
CONFIG_GPIO=y
CONFIG_SPI=y
CONFIG_SPI_NRFX=y
CONFIG_I2C=y
CONFIG_ADC=y
CONFIG_PWM=y

#need to turn these off for microbit v2 as they prevent low level fiddling with the i2c devices
CONFIG_LIS2DH=n
CONFIG_LIS2MDL=n
```

## src/main.c
```c
// Blink the top left LED in the LED matrix using director memory writes
#include <zephyr/sys/printk.h>
#include <zephyr/device.h>
#include <zephyr/kernel.h>
#include <stdint.h>

/* Port 0 starts at address 0x50000000
 * It occupies a number of addresses which are offset from this base address
 * The output register is at offset 0x504
 * The input register is at offset 0x510
 * The direction register is at offset  0x514
 * In the following example writes to registers are full 32 bit
 * writes (rather than focussing on a particular * bit).  This is
 * not good practice but it keeps the example really simple
*/
#define P0_OUT (*(volatile uint32_t *)0x50000504)
#define P0_IN  (*(volatile uint32_t *)0x50000510)
#define P0_DIR (*(volatile uint32_t *)0x50000514)


int main(void)
{
	int ret;
	// Row 1 Anode is connected to GPIO0.21
	// Col 1 Cathode is connected to GPIO0.28
	P0_DIR |= (1 << 21) + (1 << 28); // Make bits 21 and 28 outputs)
	P0_OUT &= ~(1 << 28); // Drive Cathode low
	while (1) {
		P0_OUT |= (1 << 21);	// drive anode high
		k_msleep(100);			// wait 100ms
		P0_OUT &= ~(1 << 21); 	// drive anode low
		k_msleep(100);			// wait 100ms
	}
	return 0;
}
```
