## prj.conf
```kconfig
# Incresed stack due to settings API usage
CONFIG_SYSTEM_WORKQUEUE_STACK_SIZE=2048

CONFIG_BT=y
# Security manager protocol support for pairing
CONFIG_BT_SMP=y
# used to sign authenticated data
CONFIG_BT_SIGNING=y
# select peripheral role
CONFIG_BT_PERIPHERAL=y
# enable GATT device information service
CONFIG_BT_DIS=n
# number of buffers available for GATT writing
CONFIG_BT_ATT_PREPARE_COUNT=5
# enable battery service
#CONFIG_BT_BAS=y
# enable Heartrate service
#CONFIG_BT_HRS=y
# enables local privacy feature support (Random MAC)
CONFIG_BT_PRIVACY=n
# name that appears when browsing
CONFIG_BT_DEVICE_NAME="Microbit V2 BLE"
# https://specificationrefs.bluetooth.com/assigned-values/Appearance%20Values.pdf
# 833 = 0x341 = Heartrate belt
#CONFIG_BT_DEVICE_APPEARANCE=833
# 0x4c0 = generic control device = 1216
CONFIG_BT_DEVICE_APPEARANCE=1216
# disable updating of device name to prevent use of generic name
# enable run-time changing of device name
CONFIG_BT_DEVICE_NAME_DYNAMIC=n
CONFIG_BT_DEVICE_NAME_MAX=65

CONFIG_BT_KEYS_OVERWRITE_OLDEST=y
CONFIG_BT_SETTINGS=n
CONFIG_FLASH=y
CONFIG_FLASH_PAGE_LAYOUT=y
CONFIG_FLASH_MAP=y
CONFIG_NVS=y
CONFIG_SETTINGS=y


CONFIG_STDOUT_CONSOLE=y
CONFIG_CBPRINTF_FP_SUPPORT=y

CONFIG_STDOUT_CONSOLE=y
CONFIG_GPIO=y
CONFIG_SPI=y
CONFIG_SPI_NRFX=y
CONFIG_I2C=y
CONFIG_ADC=y
CONFIG_PWM=y

#need to turn these off for microbit v2 as they prevent low level fiddling with the i2c devices
CONFIG_LIS2DH=n
CONFIG_LIS2MDL=n
```

## src/main.c
```c
#include <zephyr/types.h>
#include <stddef.h>
#include <zephyr/sys/printk.h>
#include <zephyr/kernel.h>
#include "matrix.h"
#include "buttons.h"

void my_button_a_callback(void);

int main(void)
{
	int ret;
  	ret = buttons_begin();
  	if (ret < 0)
  	{
		printk("Error initializing the buttons\n");
		return -1;
	}
	ret = matrix_begin();
	if (ret < 0)
  	{
		printk("Error initializing the matrix\n");
		return -2;
	}
	attach_callback_to_button_a(my_button_a_callback);
	while (1) {
		k_msleep(100);
	}
	return 0;
}
void my_button_a_callback(void)
{
	static int state=0;
	if (state == 1)
	{
		matrix_put_pattern(0x1f,0);
	}
	else
	{
		matrix_put_pattern(0,0);
	}
	state = state ^ 1;
}
```

## src/buttons.c
```c
#include <stdint.h>
#include <zephyr/sys/printk.h>
#include <zephyr/device.h>
#include <zephyr/drivers/gpio.h>
#include <stdio.h>
#include "buttons.h"
// Both buttons are on GPIO0
#define BUTTON_A_PORT_BIT 14
#define BUTTON_B_PORT_BIT 23
static const struct device *gpio_0;


int get_buttonA()
{
	return gpio_pin_get(gpio_0,BUTTON_A_PORT_BIT);
}
int get_buttonB()
{
	return gpio_pin_get(gpio_0,BUTTON_B_PORT_BIT);
}
int buttons_begin()
{
	int ret;
	// Configure the GPIO's 	
	gpio_0=DEVICE_DT_GET(DT_NODELABEL(gpio0));
	if (gpio_0 == NULL)
	{
		printf("Error acquiring GPIO 0 interface\n");
		return -1;
	}
	ret = gpio_pin_configure(gpio_0,BUTTON_A_PORT_BIT,GPIO_INPUT);
	ret = gpio_pin_configure(gpio_0,BUTTON_B_PORT_BIT,GPIO_INPUT);
	return 0;

}

static fptr button_a_user_handler = NULL;
static struct gpio_callback button_a_cb;
static void button_a_handler(const struct device *dev, struct gpio_callback *cb, uint32_t pins)
{
	printk("interrupt\n");
	if (button_a_user_handler)
	{
		button_a_user_handler();
	}
}
int attach_callback_to_button_a(fptr callback_function)
{
	if (gpio_pin_interrupt_configure(gpio_0,BUTTON_A_PORT_BIT,GPIO_INT_EDGE_FALLING) < 0)
	{
		printk("Error configuring interrupt for button A\n");
	}
	gpio_init_callback(&button_a_cb, button_a_handler, (1 << BUTTON_A_PORT_BIT) );	
    if (gpio_add_callback(gpio_0, &button_a_cb) < 0)
	{
		printk("Error adding callback for button A\n");
	}
	else
	{
		// success so far so use the user supplied callback function
		button_a_user_handler = callback_function;
	}

	return 0;
}
```

## src/buttons.h
```c
#ifndef __BUTTONS_H
#define __BUTTONS_H
int get_buttonA();
int get_buttonB();
int buttons_begin();
typedef void (*fptr)(void);
int attach_callback_to_button_a(fptr callback_function);

#endif
```
