## prj.conf
```kconfig
# enable GPIO
CONFIG_GPIO=y

# clock control
CONFIG_CLOCK_CONTROL_NRF_K32SRC_RC=y
CONFIG_CLOCK_CONTROL_NRF_K32SRC_250PPM=y

# enable uart driver
CONFIG_SERIAL=y
CONFIG_STDOUT_CONSOLE=y
```

## src/main.c
```c
/*
 * SPDX-License-Identifier: Apache-2.0
*/

#include <zephyr/zephyr.h>
#include <zephyr/sys/printk.h>
#include <zephyr/device.h>
#include <zephyr/drivers/gpio.h>
#include <stdio.h>
#include "matrix.h"
#include "buttons.h"
volatile uint8_t rows = 1;
volatile uint8_t cols = 1;
void button_a_pressed(void)
{
	cols = cols << 1;
	if (cols > 16)
	{
		cols = 1;
		rows = rows << 1;
		if (rows > 16)
		{
			rows = 1;
		}
	}
}
void main(void)
{
	int ret;
	ret = matrix_begin();
	if (ret < 0)
	{
		printf("\nError initializing LED matrix.  Error code = %d\n",ret);	
		while(1);
	}
	ret = buttons_begin();	
	if (ret < 0)
	{
		printf("\nError initializing buttons.  Error code = %d\n",ret);	
		while(1);
	}	
	attach_callback_to_button_a(button_a_pressed);
	while(1)
	{       
		matrix_put_pattern(rows, ~cols);
		k_msleep(100);
		
	}
}
```

## src/buttons.c
```c
#include <stdint.h>
#include <zephyr/sys/printk.h>
#include <zephyr/device.h>
#include <zephyr/drivers/gpio.h>
#include <stdio.h>
#include "buttons.h"
// Both buttons are on GPIO0
#define BUTTON_A_PORT_BIT 14
#define BUTTON_B_PORT_BIT 23
static const struct device *gpio0;


int get_buttonA()
{
	return gpio_pin_get(gpio0,BUTTON_A_PORT_BIT);
}
int get_buttonB()
{
	return gpio_pin_get(gpio0,BUTTON_B_PORT_BIT);
}
int buttons_begin()
{
	int ret;
	// Configure the GPIO's 	
	gpio0=device_get_binding("GPIO_0");
	if (gpio0 == NULL)
	{
		printf("Error acquiring GPIO 0 interface\n");
		return -1;
	}
	ret = gpio_pin_configure(gpio0,BUTTON_A_PORT_BIT,GPIO_INPUT);
	ret = gpio_pin_configure(gpio0,BUTTON_B_PORT_BIT,GPIO_INPUT);
	return 0;
}

static fptr button_a_user_handler = NULL;
static struct gpio_callback button_a_cb;
static void button_a_handler(const struct device *dev, struct gpio_callback *cb, uint32_t pins)
{
	printk("interrupt\n");
	if (button_a_user_handler)
	{
		button_a_user_handler();
	}
}
int attach_callback_to_button_a(fptr callback_function)
{
	if (gpio_pin_interrupt_configure(gpio0,BUTTON_A_PORT_BIT,GPIO_INT_EDGE_FALLING) < 0)
	{
		printk("Error configuring interrupt for button A\n");
	}
	gpio_init_callback(&button_a_cb, button_a_handler, (1 << BUTTON_A_PORT_BIT) );	
    if (gpio_add_callback(gpio0, &button_a_cb) < 0)
	{
		printk("Error adding callback for button A\n");
	}
	else
	{
		// success so far so use the user supplied callback function
		button_a_user_handler = callback_function;
	}

	return 0;
}
```

## src/buttons.h
```c
#ifndef __BUTTONS_H
#define __BUTTONS_H
#include <zephyr/zephyr.h>
#include <zephyr/device.h>	
#include <stdio.h>
// A typedef for a function pointer for an interrupt callback
typedef void (*fptr)(void);

int get_buttonA();
int get_buttonB();
int buttons_begin();
int attach_callback_to_button_a(fptr callback_function);
#endif
```

## src/matrix.c
```c
#include <stdint.h>
#include <zephyr/sys/printk.h>
#include <zephyr/device.h>
#include <zephyr/drivers/gpio.h>
#include <stdio.h>
#include "matrix.h"
#define ROW1_PORT_BIT 21
#define ROW2_PORT_BIT 22
#define ROW3_PORT_BIT 15
#define ROW4_PORT_BIT 24
#define ROW5_PORT_BIT 19

#define COL1_PORT_BIT 28
#define COL2_PORT_BIT 11
#define COL3_PORT_BIT 31
#define COL4_PORT_BIT 5
#define COL5_PORT_BIT 30

static const struct device *gpio0, *gpio1;		
void set_row1(int state)
{
	gpio_pin_set(gpio0,ROW1_PORT_BIT,state);
}
void set_row2(int state)
{
	gpio_pin_set(gpio0,ROW2_PORT_BIT,state);
}
void set_row3(int state)
{
	gpio_pin_set(gpio0,ROW3_PORT_BIT,state);
}
void set_row4(int state)
{
	gpio_pin_set(gpio0,ROW4_PORT_BIT,state);
}
void set_row5(int state)
{
	gpio_pin_set(gpio0,ROW5_PORT_BIT,state);
}
void set_col1(int state)
{
	gpio_pin_set(gpio0,COL1_PORT_BIT,state);
}
void set_col2(int state)
{
	gpio_pin_set(gpio0,COL2_PORT_BIT,state);
}
void set_col3(int state)
{
	gpio_pin_set(gpio0,COL3_PORT_BIT,state);
}
void set_col4(int state)
{
	gpio_pin_set(gpio1,COL4_PORT_BIT,state);
}
void set_col5(int state)
{
	gpio_pin_set(gpio0,COL5_PORT_BIT,state);
}
int matrix_begin()
{
	int ret;
	// Configure the GPIO's 	
	gpio0=device_get_binding("GPIO_0");
	if (gpio0 == NULL)
	{
		printf("Error acquiring GPIO 0 interface\n");
		return -1;
	}
	gpio1=device_get_binding("GPIO_1");
	if (gpio0 == NULL)
	{
		printf("Error acquiring GPIO 1 interface\n");
 		return -2;
	}
	ret = gpio_pin_configure(gpio0,ROW1_PORT_BIT,GPIO_OUTPUT);
	ret = gpio_pin_configure(gpio0,ROW2_PORT_BIT,GPIO_OUTPUT);
	ret = gpio_pin_configure(gpio0,ROW3_PORT_BIT,GPIO_OUTPUT);
	ret = gpio_pin_configure(gpio0,ROW4_PORT_BIT,GPIO_OUTPUT);
	ret = gpio_pin_configure(gpio0,ROW5_PORT_BIT,GPIO_OUTPUT);
	
	ret = gpio_pin_configure(gpio0,COL1_PORT_BIT,GPIO_OUTPUT);
	ret = gpio_pin_configure(gpio0,COL2_PORT_BIT,GPIO_OUTPUT);
	ret = gpio_pin_configure(gpio0,COL3_PORT_BIT,GPIO_OUTPUT);
	ret = gpio_pin_configure(gpio1,COL4_PORT_BIT,GPIO_OUTPUT);
	ret = gpio_pin_configure(gpio0,COL5_PORT_BIT,GPIO_OUTPUT);
	
	matrix_all_off();	
	return 0;	
}
void matrix_put_pattern(uint8_t rows, uint8_t cols)
{
	set_row1(rows & 1);
	rows = rows >> 1;
	set_row2(rows & 1);
	rows = rows >> 1;
	set_row3(rows & 1);
	rows = rows >> 1;
	set_row4(rows & 1);
	rows = rows >> 1;
	set_row5(rows & 1);
	
	set_col1(cols & 1);
	cols = cols >> 1;
	set_col2(cols & 1);
	cols = cols >> 1;
	set_col3(cols & 1);
	cols = cols >> 1;
	set_col4(cols & 1);
	cols = cols >> 1;
	set_col5(cols & 1);
}
void matrix_all_off()
{
	set_row1(0);
	set_row2(0);
	set_row3(0);
	set_row4(0);
	set_row5(0);
	
	set_col1(1);
	set_col2(1);
	set_col3(1);
	set_col4(1);
	set_col5(1);
	
}
```
