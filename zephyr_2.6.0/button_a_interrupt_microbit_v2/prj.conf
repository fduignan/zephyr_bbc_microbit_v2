## CMakeLists.txt
```
# SPDX-License-Identifier: Apache-2.0

cmake_minimum_required(VERSION 3.13.1)

find_package(Zephyr REQUIRED HINTS $ENV{ZEPHYR_BASE})
project(hello_world)

target_sources(app PRIVATE src/main.c)
zephyr_include_directories(${ZEPHYR_BASE}/boards/arm/bbc_microbit_v2)
```

## prj.conf
```kconfig
# nothing here
CONFIG_GPIO=y
```

## src/main.c
```c
/*
 * SPDX-License-Identifier: Apache-2.0
 */

#include <zephyr.h>
#include <sys/printk.h>
#include <device.h>
#include <drivers/gpio.h>

// Lights an LED attached to pin 2 of the connector/breakout when button A is pressed
static const struct gpio_dt_spec button_a = GPIO_DT_SPEC_GET(DT_NODELABEL(buttona), gpios);
static struct gpio_callback button_a_cb;
struct device *gpio;
void button_a_pressed(const struct device *dev, struct gpio_callback *cb, uint32_t pins)
{
	gpio_pin_toggle(gpio,2);
}

void main(void)
{
	int ret;

	printk("Hello World! %s\n", CONFIG_BOARD);
	gpio=device_get_binding("GPIO_0");
	ret = gpio_pin_configure(gpio,2,GPIO_OUTPUT);
	ret = gpio_pin_configure_dt(&button_a,GPIO_INPUT | GPIO_PULL_UP);
	ret = gpio_pin_interrupt_configure_dt(&button_a,GPIO_INT_EDGE_TO_ACTIVE);
	gpio_init_callback(&button_a_cb, button_a_pressed, BIT(button_a.pin) );
	gpio_add_callback(button_a.port, &button_a_cb);
	while(1)
	{

	}
}
```
